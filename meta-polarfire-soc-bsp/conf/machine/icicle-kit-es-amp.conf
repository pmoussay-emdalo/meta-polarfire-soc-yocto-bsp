## meta-polarfire-soc-bsp/conf/machine/icicle-kit-es-amp.conf
```bitbake
#@TYPE: Machine
#@NAME: icicle-kit-es-amp
#@SOC: Polarfire SoC
#@DESCRIPTION: Machine configuration for the Microchip Polarfire SoC, Icicle Kit Engineering Sample in AMP mode

require include/mpfs-common.inc

MACHINE_TYPE = "amp"

RISCV_SBI_FDT ?=  "mpfs-icicle-kit-context-a.dtb"
KERNEL_DTC_FLAGS += "-@"
KERNEL_DEVICETREE ?= "microchip/${RISCV_SBI_FDT}"

UBOOT_CONFIG = "mpfs_icicle"
UBOOT_CONFIG[mpfs_icicle] = "microchip_mpfs_icicle_amp_defconfig"

## Generate a boot.scr file which should be included
##  in the boot partition. It will try to load a kernel image from mmc
UBOOT_ENV = "boot"
UBOOT_ENV_SUFFIX = "scr"
UBOOT_ENV_SIZE = "0x2000"

# Name translation for zephyr related project build
ZEPHYR_BOARD = "mpfs_icicle"
# By defining that variable, we request zephyr to use it's own toolchain
ZEPHYR_TOOLCHAIN_VARIANT = "zephyr"

## Select the YAML file used for building the HSS payload
HSS_PAYLOAD = "amp"

## Set this to "freertos" for a Linux + FreeRTOS demo or "bm" for a Linux + Bare Metal demo
# Or set it to "zephyr" for a Linux + Zephyr demo
AMP_DEMO = "freertos"
# AMP_DEMO = "zephyr"
# AMP_DEMO = "bm"

IMAGE_INSTALL:append = " polarfire-soc-amp-examples mpfs-zephyr-amp-demo"

IMAGE_BOOT_FILES ?= " \
    fitImage \
    boot.scr \
    uboot.env \
"

WKS_FILE ?= "mpfs-rootfs.wks"
```
